## sw/meta-altera-fpga-ocs/conf/layer.conf
```bitbake
# *******************************************************************************
# Copyright (C) Altera Corporation
#
# This code and the related documents are Altera copyrighted materials and your
# use of them is governed by the express license under which they were provided to
# you ("License"). This code and the related documents are provided as is, with no
# express or implied warranties other than those that are expressly stated in the 
# License.
# *******************************************************************************/

# We have a conf and classes directory, add to BBPATH
BBPATH .= ":${LAYERDIR}"

# We have recipes-* directories, add to BBFILES
BBFILES += "${LAYERDIR}/recipes-*/*/*.bb \
            ${LAYERDIR}/recipes-*/*/*.bbappend"

BBFILE_COLLECTIONS += "meta-intel-fpga-omnitek"
BBFILE_PATTERN_meta-intel-fpga-omnitek = "^${LAYERDIR}/"
BBFILE_PRIORITY_meta-intel-fpga-omnitek = "6"

LAYERSERIES_COMPAT_meta-intel-fpga-omnitek = "nanbield scarthgap"

ERROR_QA:remove = "buildpaths"
WARN_QA:append = " buildpaths"
```

## sw/meta-altera-fpga/meta-altera-devkit/conf/machine/agilex5_mk_a5e065bb32aes1.conf
```bitbake
#@TYPE: Machine
#@NAME: Intel SoCFPGA Agilex5
#@DESCRIPTION: Machine configuration for the Agilex5 SoCFPGA

require conf/machine/include/agilex5-devkit.inc
```

## sw/meta-vvp-isp-demo/conf/layer.conf
```bitbake
BBPATH .= ":${LAYERDIR}"

BBFILES += "${LAYERDIR}/recipes-*/*.bb"
BBFILES += "${LAYERDIR}/recipes-*/*/*.bb"
BBFILES += "${LAYERDIR}/recipes-*/*/*.bbappend"

BBFILE_COLLECTIONS += "meta-vvp-isp-demo"
BBFILE_PATTERN_meta-vvp-isp-demo = "^${LAYERDIR}/"
BBFILE_PRIORITY_meta-vvp-isp-demo = "7"

LAYERDEPENDS_meta-vvp-isp-demo = "core"
LAYERSERIES_COMPAT_meta-vvp-isp-demo = "nanbield scarthgap"

WKS_FILE="vvp-isp-demo-image.wks"

FPGA_CORE_FILE = "top.core.rbf"
SOCFPGA_FEATURES:append = " bitstream"

IMAGE_BOOT_FILES:${MACHINE} = " \
	${UBOOT_BINARY} \
	Image \
        devicetree/${DTS_NAME}.dtb;${DTS_NAME}.dtb \
	boot.scr.uimg \
	${FPGA_CORE_FILE} \
"
```
